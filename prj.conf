## CMakeLists.txt
```
# =============================================================================
# Balancing Robot - Main CMake Configuration
# =============================================================================
# Self-contained build for the STM32 self-balancing robot.
#
# Supported boards (BOARD cache variable, see cmake/boards/):
#   - f103: Blue Pill (STM32F103C8T6)
#   - f407: Hiwonder ROS Robot Control Board (STM32F407VET6)
#
# Dependencies (as git submodules):
#   - libopencm3: Open-source ARM Cortex-M firmware library
#   - FreeRTOS-Kernel: Real-time operating system
#
# Build instructions:
#   cmake --preset f103        (or f407)
#   cmake --build --preset f103
#
# Author: Thiago Cunha
# =============================================================================

cmake_minimum_required(VERSION 3.21)

# Project definition
project(balancing-robot
    VERSION 1.0.0
    DESCRIPTION "Self-balancing robot with STM32 and FreeRTOS"
    LANGUAGES C ASM
)

# =============================================================================
# Build Configuration
# =============================================================================

set(CMAKE_C_STANDARD 99)
set(CMAKE_C_STANDARD_REQUIRED ON)
set(CMAKE_EXPORT_COMPILE_COMMANDS ON)

# Paths
set(LIBOPENCM3_DIR ${CMAKE_SOURCE_DIR}/lib/libopencm3)
set(SRC_DIR ${CMAKE_SOURCE_DIR}/src)
set(GENERATED_DIR ${CMAKE_BINARY_DIR}/generated)

# Host unit tests (cmake --preset host): no board, no cross compiler
option(ROBOT_HOST_TESTS "Build the host unit tests instead of the firmware" OFF)
if(ROBOT_HOST_TESTS)
    enable_testing()
    add_subdirectory(test/host)
    return()
endif()

# =============================================================================
# Board Selection
# =============================================================================

set(BOARDS f103 f407)
set(BOARD f103 CACHE STRING "Target board (${BOARDS})")
set_property(CACHE BOARD PROPERTY STRINGS ${BOARDS})

if(NOT BOARD IN_LIST BOARDS)
    message(FATAL_ERROR "Unknown BOARD '${BOARD}'. Valid boards: ${BOARDS}")
endif()

# Sets MCU_*, LIBOPENCM3_*, LINKER_SCRIPT, CPU_FLAGS, FREERTOS_*, SYS_CLOCK_HZ,
# BOARD_SOURCE, BOARD_INCLUDE_DIR, MOTOR_SOURCE and BOARD_DEFAULT_* (see below)
include(${CMAKE_SOURCE_DIR}/cmake/boards/${BOARD}.cmake)

# =============================================================================
# Configuration: prj.conf, board .conf and overlays (see cmake/features.cmake)
# =============================================================================

include(${CMAKE_SOURCE_DIR}/cmake/features.cmake)
robot_load_configuration()

# ---- Values -----------------------------------------------------------------

robot_option(APP_BLINK_ONLY BOOL OFF "Only run the LED heartbeat task (no drivers, all features off)")
robot_option(UART_BAUDRATE INT 921600 "USB console baud rate (telemetry and AT commands)")
robot_option(BT_MODULE STRING hc06 "Module on the Bluetooth header: HC-06 (classic Bluetooth) or the AtomS3R-CAM bridge (BLE + camera, atom/)"
    CHOICES hc06 atom)
if(BT_MODULE STREQUAL "atom")
    set(BT_DEFAULT_BAUDRATE 115200)     # atom/main/Kconfig.projbuild: ATOM_ROBOT_BAUDRATE
else()
    set(BT_DEFAULT_BAUDRATE 9600)       # HC-06 factory speed
endif()
robot_option(BT_BAUDRATE INT ${BT_DEFAULT_BAUDRATE} "Bluetooth console baud rate; must match the module")
robot_option(IMU_SAMPLE_RATE_MS INT 10 "IMU and control loop period in ms")
robot_option(FREERTOS_TICK_RATE_HZ INT 1000 "FreeRTOS tick rate in Hz")
robot_option(FREERTOS_TOTAL_HEAP_SIZE INT ${BOARD_DEFAULT_HEAP_SIZE} "FreeRTOS heap size in bytes")
robot_option(IMU_SENSOR STRING ${BOARD_DEFAULT_IMU} "IMU chip on the board"
    CHOICES mpu6050 qmi8658)
robot_option(ATTITUDE_FILTER STRING complementary "Tilt estimator used by the balance loop"
    CHOICES complementary kalman)

# The filters and PID use IMU_SAMPLE_RATE_MS as dt, so the task period must be exact
math(EXPR IMU_SAMPLE_PERIOD_REMAINDER "(${IMU_SAMPLE_RATE_MS} * ${FREERTOS_TICK_RATE_HZ}) % 1000")
if(NOT IMU_SAMPLE_PERIOD_REMAINDER EQUAL 0)
    message(FATAL_ERROR
        "IMU_SAMPLE_RATE_MS=${IMU_SAMPLE_RATE_MS} is not a whole number of ticks at "
        "FREERTOS_TICK_RATE_HZ=${FREERTOS_TICK_RATE_HZ}: the loop period would differ from dt."
    )
endif()

# ---- Features ---------------------------------------------------------------

robot_feature(CONSOLE_USB ON "AT console on the USB console UART; carries telemetry and fault reports"
    REQUIRES "NOT APP_BLINK_ONLY")
robot_feature(CONSOLE_BT ${BOARD_HAS_BT_UART} "AT console on the Bluetooth module UART"
    REQUIRES "NOT APP_BLINK_ONLY" BOARD_HAS_BT_UART)
robot_define(CONSOLE_ANY CONSOLE_USB OR CONSOLE_BT)

if(CONSOLE_ANY)
    # Shared by both consoles
    set_property(GLOBAL APPEND PROPERTY ROBOT_FEATURE_SOURCES
        ${SRC_DIR}/drivers/uart.c
        ${SRC_DIR}/cmd/at_cmd.c
        ${SRC_DIR}/util/fmt.c
        ${SRC_DIR}/robot/robot_commands.c
        ${SRC_DIR}/app/console.c
    )
endif()

robot_feature(CONSOLE_ECHO ON "Echo each command line on the USB console" REQUIRES CONSOLE_USB)
robot_feature(TELEMETRY ON "AT+STREAM control loop telemetry on the USB console"
    REQUIRES CONSOLE_USB SOURCES ${SRC_DIR}/telemetry/telemetry.c)
robot_feature(AT_CMD_PID_TOGGLE ON "AT+PID, AT+PIDON and AT+PIDOFF commands" REQUIRES CONSOLE_ANY)
robot_feature(AT_CMD_HELP OFF "AT+HELP command" REQUIRES CONSOLE_ANY)
robot_feature(AT_CMD_ALL_QUERY OFF "AT+ALL? bulk sensor query" REQUIRES CONSOLE_ANY)
robot_feature(LOGGING OFF "Debug log messages on the USB console (~300 bytes stack)" REQUIRES CONSOLE_USB)
robot_feature(FAULT_VERBOSE ON "Print fault reports on the USB console" REQUIRES CONSOLE_USB)
robot_feature(WATCHDOG ON "Independent watchdog refreshed by the control task" REQUIRES "NOT APP_BLINK_ONLY")
robot_feature(I2C_BUS_RECOVERY ON "Free a stuck I2C slave at start-up" REQUIRES "NOT APP_BLINK_ONLY")
robot_feature(BUTTON_ENABLE ${BOARD_HAS_BUTTON} "Board button arms balancing (starts when lifted upright) and stops it"
    REQUIRES "NOT APP_BLINK_ONLY" BOARD_HAS_BUTTON SOURCES ${SRC_DIR}/ui/button.c)
robot_feature(BOOTLOADER ${BOARD_HAS_BOOTLOADER} "Serial bootloader in flash sector 0: updates over the console (AT+UPDATE)"
    REQUIRES BOARD_HAS_BOOTLOADER CONSOLE_USB)
if(BOOTLOADER)
    # The firmware is linked behind the bootloader and its header
    set(LINKER_SCRIPT ${BOARD_APP_LINKER_SCRIPT})
endif()
robot_feature(SPEED_LOOP ${BOARD_HAS_QUADRATURE_ENCODERS} "Outer speed loop from the wheel encoders (AT+VLOOP)"
    REQUIRES BOARD_HAS_QUADRATURE_ENCODERS "NOT APP_BLINK_ONLY")
robot_feature(AUTO_ENABLE OFF "Start balancing once per boot after the robot is held upright"
    REQUIRES "NOT APP_BLINK_ONLY")

if(NOT APP_BLINK_ONLY AND NOT CONSOLE_ANY AND NOT AUTO_ENABLE AND NOT BUTTON_ENABLE)
    message(FATAL_ERROR
        "CONSOLE_USB and CONSOLE_BT are both off, so nothing could send AT+ENABLE.\n"
        "Enable a console, AUTO_ENABLE or BUTTON_ENABLE."
    )
endif()

robot_write_config_header(${SRC_DIR}/app_config.h.in ${GENERATED_DIR}/app_config.h)

# =============================================================================
# Check Dependencies
# =============================================================================

if(NOT EXISTS ${LIBOPENCM3_DIR}/include)
    message(FATAL_ERROR
        "libopencm3 not found!\n"
        "Run './scripts/setup.sh' to initialize the project, or:\n"
        "  git submodule update --init --recursive\n"
        "  cd lib/libopencm3 && make TARGETS=${LIBOPENCM3_TARGET}"
    )
endif()

if(NOT EXISTS ${LIBOPENCM3_LIB})
    message(FATAL_ERROR
        "libopencm3 not built for ${MCU_FAMILY}!\n"
        "Run: cd lib/libopencm3 && make TARGETS=${LIBOPENCM3_TARGET}"
    )
endif()

list(GET FREERTOS_SOURCES 0 FREERTOS_FIRST_SOURCE)
if(NOT EXISTS ${FREERTOS_FIRST_SOURCE})
    message(FATAL_ERROR
        "FreeRTOS sources not found!\n"
        "Run: git submodule update --init lib/FreeRTOS-Kernel"
    )
endif()

# =============================================================================
# Compiler Flags
# =============================================================================

add_compile_options(${CPU_FLAGS})
add_link_options(${CPU_FLAGS})

# Warning flags
add_compile_options(
    -Wall
    -Wextra
    -Wshadow
    -Wundef
    -Wimplicit-function-declaration
    -Wredundant-decls
    -Wmissing-prototypes
    -Wstrict-prototypes
)

# Optimization and debug flags
add_compile_options(
    -Os
    -g
    -fno-common
    -ffunction-sections
    -fdata-sections
)

# MCU definition
add_compile_definitions(${MCU_FAMILY})

# =============================================================================
# FreeRTOS Library
# =============================================================================

add_library(freertos STATIC ${FREERTOS_SOURCES})
# NOTE: src/rtos_glue/opencm3.c is linked with app (not library) to ensure interrupt
# handlers are included - static library would drop unreferenced symbols

target_include_directories(freertos PUBLIC
    ${FREERTOS_INCLUDE_DIRS}
    ${SRC_DIR}  # For FreeRTOSConfig.h
    ${GENERATED_DIR}
    ${LIBOPENCM3_DIR}/include
)

# =============================================================================
# Application Sources
# =============================================================================

set(APP_SOURCES
    ${SRC_DIR}/main.c
    ${SRC_DIR}/app/app_init.c
    ${SRC_DIR}/fault/fault_handlers.c
    ${SRC_DIR}/led/led.c
    ${SRC_DIR}/log/log.c
    ${BOARD_SOURCE}
    # FreeRTOS interrupt handlers - must be in app to ensure linkage
    ${SRC_DIR}/rtos_glue/opencm3.c
)

if(NOT APP_BLINK_ONLY)
    list(APPEND APP_SOURCES
        ${SRC_DIR}/interrupts.c
        ${SRC_DIR}/drivers/i2c.c
        ${SRC_DIR}/drivers/pwm.c
        ${SRC_DIR}/filter/kalman.c
        ${SRC_DIR}/filter/complementary.c
        ${SRC_DIR}/imu/imu.c
        ${SRC_DIR}/imu/${IMU_SENSOR}.c
        ${MOTOR_SOURCE}
        ${SRC_DIR}/robot/robot.c
        ${SRC_DIR}/control/pid.c
        ${SRC_DIR}/control/mixer.c
    )
endif()

# Sources of enabled features
get_property(FEATURE_SOURCES GLOBAL PROPERTY ROBOT_FEATURE_SOURCES)
list(APPEND APP_SOURCES ${FEATURE_SOURCES})

# =============================================================================
# Main Executable
# =============================================================================

add_executable(${PROJECT_NAME}.elf ${APP_SOURCES})

target_include_directories(${PROJECT_NAME}.elf PRIVATE
    ${SRC_DIR}
    ${BOARD_INCLUDE_DIR}
    ${GENERATED_DIR}
    ${LIBOPENCM3_DIR}/include
)

target_link_libraries(${PROJECT_NAME}.elf PRIVATE
    freertos
    ${LIBOPENCM3_LIB}
    m  # math library
)

# Linker flags
target_link_options(${PROJECT_NAME}.elf PRIVATE
    -T${LINKER_SCRIPT}
    -L${SRC_DIR}  # INCLUDE stm32f4_sections.ld
    -Wl,-Map=${PROJECT_NAME}.map
    -Wl,--gc-sections
    --static
    -nostartfiles
    -specs=nano.specs
    -specs=nosys.specs
    -u _printf_float  # Enable float printf
)

set_property(TARGET ${PROJECT_NAME}.elf APPEND PROPERTY LINK_DEPENDS ${LINKER_SCRIPT})

# =============================================================================
# Post-build: Generate .bin and .hex files
# =============================================================================

add_custom_command(TARGET ${PROJECT_NAME}.elf POST_BUILD
    COMMAND ${CMAKE_OBJCOPY} -Obinary ${PROJECT_NAME}.elf ${PROJECT_NAME}.bin
    COMMAND ${CMAKE_OBJCOPY} -Oihex ${PROJECT_NAME}.elf ${PROJECT_NAME}.hex
    COMMAND ${CMAKE_SIZE} ${PROJECT_NAME}.elf
    COMMENT "Generating ${PROJECT_NAME}.bin and ${PROJECT_NAME}.hex"
)

# =============================================================================
# Bootloader (BOOTLOADER feature, src/bootloader)
# =============================================================================

if(BOOTLOADER)
    find_package(Python3 REQUIRED COMPONENTS Interpreter)

    add_executable(bootloader.elf ${SRC_DIR}/bootloader/bootloader.c)
    target_include_directories(bootloader.elf PRIVATE
        ${SRC_DIR} ${BOARD_INCLUDE_DIR} ${LIBOPENCM3_DIR}/include)
    target_link_libraries(bootloader.elf PRIVATE ${LIBOPENCM3_LIB})
    target_link_options(bootloader.elf PRIVATE
        -T${BOARD_BOOTLOADER_LINKER_SCRIPT} -L${SRC_DIR}
        -Wl,-Map=bootloader.map -Wl,--gc-sections --static -nostartfiles
        -specs=nano.specs -specs=nosys.specs)
    set_property(TARGET bootloader.elf APPEND PROPERTY LINK_DEPENDS ${BOARD_BOOTLOADER_LINKER_SCRIPT})
    add_custom_command(TARGET bootloader.elf POST_BUILD
        COMMAND ${CMAKE_OBJCOPY} -Obinary bootloader.elf bootloader.bin
        COMMAND ${CMAKE_SIZE} bootloader.elf
        COMMENT "Generating bootloader.bin")

    # Header (magic, size, CRC32) + firmware, as the bootloader would write it:
    # what the ST-Link flashes at 0x08004000
    add_custom_command(TARGET ${PROJECT_NAME}.elf POST_BUILD
        COMMAND ${Python3_EXECUTABLE} ${CMAKE_SOURCE_DIR}/scripts/make_app_image.py
            ${PROJECT_NAME}.bin ${PROJECT_NAME}.img
        COMMENT "Generating ${PROJECT_NAME}.img (application header + firmware)")
    add_dependencies(${PROJECT_NAME}.elf bootloader.elf)
endif()

# =============================================================================
# Flash Targets
# =============================================================================

find_program(STFLASH st-flash)

set(CONSOLE_PORT /dev/ttyACM0 CACHE STRING "USB console serial port (flash-usb)")

if(STFLASH AND BOOTLOADER)
    add_custom_target(flash
        COMMAND ${STFLASH} --reset write ${PROJECT_NAME}.img 0x08004000
        DEPENDS ${PROJECT_NAME}.elf
        COMMENT "Flashing ${PROJECT_NAME}.img behind the bootloader over ST-Link"
    )
    add_custom_target(flash-bootloader
        COMMAND ${STFLASH} --reset write bootloader.bin 0x08000000
        DEPENDS bootloader.elf
        COMMENT "Flashing bootloader.bin to sector 0 over ST-Link"
    )
elseif(STFLASH)
    add_custom_target(flash
        COMMAND ${STFLASH} write ${PROJECT_NAME}.bin 0x8000000
        DEPENDS ${PROJECT_NAME}.elf
        COMMENT "Flashing ${PROJECT_NAME}.bin to ${MCU_MODEL} over ST-Link"
    )
else()
    message(STATUS "st-flash not found - 'flash' target will not be available")
endif()

set(SERIAL_PORT /dev/ttyUSB0 CACHE STRING "Serial port for flash-serial")
# stm32flash -i syntax: <enter sequence>:<exit sequence>
set(SERIAL_BOOT_SEQUENCE "-dtr&rts,dtr:-rts" CACHE STRING
    "DTR/RTS sequence stm32flash uses to enter the ROM bootloader")

if(BOOTLOADER)
    add_custom_target(flash-usb
        COMMAND ${Python3_EXECUTABLE} ${CMAKE_SOURCE_DIR}/scripts/flash_usb.py
            --port ${CONSOLE_PORT} ${PROJECT_NAME}.bin
        DEPENDS ${PROJECT_NAME}.elf
        COMMENT "Updating the firmware over ${CONSOLE_PORT} (bootloader)"
        USES_TERMINAL
    )
endif()

find_program(STM32FLASH stm32flash)

if(STM32FLASH)
    add_custom_target(flash-serial
        COMMAND ${STM32FLASH} -w ${PROJECT_NAME}.bin -v -g 0x0
            -i ${SERIAL_BOOT_SEQUENCE} ${SERIAL_PORT}
        DEPENDS ${PROJECT_NAME}.elf
        COMMENT "Flashing ${PROJECT_NAME}.bin to ${MCU_MODEL} over ${SERIAL_PORT}"
        VERBATIM
    )
else()
    message(STATUS "stm32flash not found - 'flash-serial' target will not be available")
endif()

# =============================================================================
# API Documentation (Doxygen)
# =============================================================================

find_package(Doxygen OPTIONAL_COMPONENTS dot)

if(DOXYGEN_FOUND)
    set(DOXYGEN_OUTPUT_DIR ${CMAKE_BINARY_DIR}/docs)
    if(DOXYGEN_DOT_FOUND)
        set(DOXYGEN_HAVE_DOT YES)
    else()
        set(DOXYGEN_HAVE_DOT NO)
    endif()

    configure_file(${CMAKE_SOURCE_DIR}/docs/doxygen/Doxyfile.in
        ${CMAKE_BINARY_DIR}/Doxyfile @ONLY)

    add_custom_target(docs
        COMMAND ${DOXYGEN_EXECUTABLE} ${CMAKE_BINARY_DIR}/Doxyfile
        COMMENT "Generating API documentation in ${DOXYGEN_OUTPUT_DIR}/html"
        VERBATIM
    )
else()
    message(STATUS "doxygen not found - 'docs' target will not be available (sudo apt install doxygen graphviz)")
endif()

# =============================================================================
# Clean Target (removes generated files)
# =============================================================================

set_property(DIRECTORY APPEND PROPERTY ADDITIONAL_CLEAN_FILES
    ${PROJECT_NAME}.bin
    ${PROJECT_NAME}.hex
    ${PROJECT_NAME}.map
)

# =============================================================================
# Information
# =============================================================================

message(STATUS "")
message(STATUS "=== Balancing Robot Build Configuration ===")
message(STATUS "Board:          ${BOARD}")
message(STATUS "MCU:            ${MCU_MODEL}")
message(STATUS "Flash:          ${MCU_FLASH_SIZE}")
message(STATUS "RAM:            ${MCU_RAM_SIZE}")
message(STATUS "Toolchain:      ${CMAKE_C_COMPILER}")
message(STATUS "libopencm3:     ${LIBOPENCM3_LIB}")
message(STATUS "FreeRTOS:       ${FREERTOS_INCLUDE_DIRS}")
message(STATUS "Linker script:  ${LINKER_SCRIPT}")
message(STATUS "")
```

## prj.conf
```kconfig
# Balancing robot configuration
#
# KEY=VALUE per line; '#' starts a comment. Applies to every board.
# Board-specific values go in cmake/boards/<board>.conf, personal overlays in a
# file passed with -DEXTRA_CONF_FILE=my.conf, and -D<KEY>=... overrides all of
# them. Every key is documented in docs/02-build-and-configuration.md.

# ---- Consoles ----------------------------------------------------------------
CONSOLE_USB=ON
# CONSOLE_BT defaults to ON on boards with a Bluetooth port (F407 board)
CONSOLE_ECHO=ON
UART_BAUDRATE=921600

# ---- Control -----------------------------------------------------------------
IMU_SAMPLE_RATE_MS=10
ATTITUDE_FILTER=complementary
AUTO_ENABLE=OFF

# ---- Features ----------------------------------------------------------------
TELEMETRY=ON
WATCHDOG=ON
FAULT_VERBOSE=ON
I2C_BUS_RECOVERY=ON
AT_CMD_PID_TOGGLE=ON
AT_CMD_HELP=OFF
AT_CMD_ALL_QUERY=OFF
LOGGING=OFF

# ---- RTOS --------------------------------------------------------------------
FREERTOS_TICK_RATE_HZ=1000
```

## src/main.c
```c
/**
 * @file main.c
 * @brief Self-Balancing Robot - Main Application Entry
 * 
 * This project implements a two-wheeled self-balancing robot using:
 * - STM32F103C8T6 (Blue Pill) microcontroller
 * - MPU6050 IMU for tilt sensing
 * - FreeRTOS for task management
 * - Kalman and Complementary filters for sensor fusion
 * - AT command interface for remote control
 * 
 * @author Thiago Cunha
 * @date 2024
 */

#include <FreeRTOS.h>
#include <task.h>

#include "app/app_init.h"
#include "fault/fault_handlers.h"

/* ==========================================================================
 * Main Entry Point
 * ========================================================================== */

int main(void) {
    /* Initialize all hardware and subsystems */
    app_hardware_init();
    
    /* Create FreeRTOS tasks */
    app_tasks_init();
    
    /* Start scheduler - this should never return */
    vTaskStartScheduler();
    
    /* Should never reach here */
    for (;;) {}

    return 0;
}
```

## src/FreeRTOSConfig.h
```c
/*
    FreeRTOS V9.0.0 - Copyright (C) 2016 Real Time Engineers Ltd.
    All rights reserved

    VISIT http://www.FreeRTOS.org TO ENSURE YOU ARE USING THE LATEST VERSION.

    This file is part of the FreeRTOS distribution.

    FreeRTOS is free software; you can redistribute it and/or modify it under
    the terms of the GNU General Public License (version 2) as published by the
    Free Software Foundation >>>> AND MODIFIED BY <<<< the FreeRTOS exception.

    ***************************************************************************
    >>!   NOTE: The modification to the GPL is included to allow you to     !<<
    >>!   distribute a combined work that includes FreeRTOS without being   !<<
    >>!   obliged to provide the source code for proprietary components     !<<
    >>!   outside of the FreeRTOS kernel.                                   !<<
    ***************************************************************************

    FreeRTOS is distributed in the hope that it will be useful, but WITHOUT ANY
    WARRANTY; without even the implied warranty of MERCHANTABILITY or FITNESS
    FOR A PARTICULAR PURPOSE.  Full license text is available on the following
    link: http://www.freertos.org/a00114.html

    ***************************************************************************
     *                                                                       *
     *    FreeRTOS provides completely free yet professionally developed,    *
     *    robust, strictly quality controlled, supported, and cross          *
     *    platform software that is more than just the market leader, it     *
     *    is the industry's de facto standard.                               *
     *                                                                       *
     *    Help yourself get started quickly while simultaneously helping     *
     *    to support the FreeRTOS project by purchasing a FreeRTOS           *
     *    tutorial book, reference manual, or both:                          *
     *    http://www.FreeRTOS.org/Documentation                              *
     *                                                                       *
    ***************************************************************************

    http://www.FreeRTOS.org/FAQHelp.html - Having a problem?  Start by reading
    the FAQ page "My application does not run, what could be wrong?".  Have you
    defined configASSERT()?

    http://www.FreeRTOS.org/support - In return for receiving this top quality
    embedded software for free we request you assist our global community by
    participating in the support forum.

    http://www.FreeRTOS.org/training - Investing in training allows your team to
    be as productive as possible as early as possible.  Now you can receive
    FreeRTOS training directly from Richard Barry, CEO of Real Time Engineers
    Ltd, and the world's leading authority on the world's leading RTOS.

    http://www.FreeRTOS.org/plus - A selection of FreeRTOS ecosystem products,
    including FreeRTOS+Trace - an indispensable productivity tool, a DOS
    compatible FAT file system, and our tiny thread aware UDP/IP stack.

    http://www.FreeRTOS.org/labs - Where new FreeRTOS products go to incubate.
    Come and try FreeRTOS+TCP, our new open source TCP/IP stack for FreeRTOS.

    http://www.OpenRTOS.com - Real Time Engineers ltd. license FreeRTOS to High
    Integrity Systems ltd. to sell under the OpenRTOS brand.  Low cost OpenRTOS
    licenses offer ticketed support, indemnification and commercial middleware.

    http://www.SafeRTOS.com - High Integrity Systems also provide a safety
    engineered and independently SIL3 certified version for use in safety and
    mission critical applications that require provable dependability.

    1 tab == 4 spaces!
*/

#ifndef FREERTOS_CONFIG_H
#define FREERTOS_CONFIG_H

/* Board clock and RTOS sizing come from the CMake build options. */
#include "app_config.h"

/*-----------------------------------------------------------
 * Application specific definitions.
 *
 * These definitions should be adjusted for your particular hardware and
 * application requirements.
 *
 * THESE PARAMETERS ARE DESCRIBED WITHIN THE 'CONFIGURATION' SECTION OF THE
 * FreeRTOS API DOCUMENTATION AVAILABLE ON THE FreeRTOS.org WEB SITE. 
 *
 * See http://www.freertos.org/a00110.html.
 *----------------------------------------------------------*/

#define configUSE_PREEMPTION		1
#define configUSE_IDLE_HOOK		0
#define configUSE_TICK_HOOK		0
#define configCPU_CLOCK_HZ		( ( unsigned long ) SYS_CLOCK_HZ )
#define configSYSTICK_CLOCK_HZ		( configCPU_CLOCK_HZ / 8 ) /* vTaskDelay() fix */
#define configTICK_RATE_HZ		( ( TickType_t ) FREERTOS_TICK_RATE_HZ )
#define configMAX_PRIORITIES		( 5 )
#define configMINIMAL_STACK_SIZE	( ( unsigned short ) 128 )
#define configTOTAL_HEAP_SIZE		( ( size_t ) FREERTOS_TOTAL_HEAP_SIZE )
#define configMAX_TASK_NAME_LEN		( 16 )
#define configUSE_TRACE_FACILITY	0
#define configUSE_16_BIT_TICKS		0
#define configIDLE_SHOULD_YIELD		1
#define configUSE_MUTEXES		1
#define configCHECK_FOR_STACK_OVERFLOW	1

/* Co-routine definitions. */
#define configUSE_CO_ROUTINES 		0
#define configMAX_CO_ROUTINE_PRIORITIES ( 2 )

/* Set the following definitions to 1 to include the API function, or zero
to exclude the API function. */

#define INCLUDE_vTaskPrioritySet	0
#define INCLUDE_uxTaskPriorityGet	0
#define INCLUDE_vTaskDelete		0
#define INCLUDE_vTaskCleanUpResources	0
#define INCLUDE_vTaskSuspend		0
#define INCLUDE_vTaskDelayUntil		1
#define INCLUDE_vTaskDelay		1

/* This is the raw value as per the Cortex-M3 NVIC.  Values can be 255
(lowest) to 0 (1?) (highest). */
#define configKERNEL_INTERRUPT_PRIORITY 	255
/* !!!! configMAX_SYSCALL_INTERRUPT_PRIORITY must not be set to zero !!!!
See http://www.FreeRTOS.org/RTOS-Cortex-M3-M4.html. */
#define configMAX_SYSCALL_INTERRUPT_PRIORITY 	191 /* equivalent to 0xb0, or priority 11. */

/* This is the value being used as per the ST library which permits 16
priority values, 0 to 15.  This must correspond to the
configKERNEL_INTERRUPT_PRIORITY setting.  Here 15 corresponds to the lowest
NVIC value of 255. */
#define configLIBRARY_KERNEL_INTERRUPT_PRIORITY	15

/* Enable debug hooks */
#define configUSE_MALLOC_FAILED_HOOK 1

/* Also makes the port check that ISRs calling FromISR APIs respect
configMAX_SYSCALL_INTERRUPT_PRIORITY. vAssertCalled() (fault_handlers.c) disables
interrupts, stops the motors, reports file:line and halts. */
void vAssertCalled( const char *file, int line );
#define configASSERT( x )	if( ( x ) == 0 ) { vAssertCalled( __FILE__, __LINE__ ); }

#endif // FREERTOS_CONFIG_H
```

## src/config.h
```c
/**
 * @file config.h
 * @brief System-wide configuration and constants
 *
 * Fixed constants live here. Build options (board, feature flags, baud rate,
 * sample rates) are CMake options generated into app_config.h - see
 * docs/02-build-and-configuration.md.
 *
 * @author Thiago Cunha
 * @date 2024
 */

#ifndef CONFIG_H
#define CONFIG_H

#include "app_config.h"

#ifdef __cplusplus
extern "C" {
#endif // __cplusplus

/* ==========================================================================
 * Hardware Configuration
 * ========================================================================== */

/** @defgroup UART_Config UART Configuration
 *  @brief UART communication settings
 *  @{
 */
#if defined(STM32F1)
#define UART_USB_TX_BUFFER_SIZE 1024    /**< USB console TX ring buffer (bytes, power of two) */
#define TELEMETRY_QUEUE_SIZE    16      /**< Records buffered for the telemetry task */
#else
#define UART_USB_TX_BUFFER_SIZE 4096
#define TELEMETRY_QUEUE_SIZE    32
#endif // defined(STM32F1)
#define UART_BT_TX_BUFFER_SIZE  512     /**< Bluetooth console TX ring buffer (boards with BOARD_BT_UART) */
/** @} */

/* ==========================================================================
 * IMU Configuration
 * ========================================================================== */

/** @defgroup IMU_Config IMU Configuration
 *  @brief IMU sampling and calibration settings
 *  @{
 */
#define IMU_SAMPLE_RATE_S       (IMU_SAMPLE_RATE_MS / 1000.0f)
#define IMU_QUEUE_SIZE          1       /**< Latest-sample mailbox: control never works through a backlog */
#define IMU_STALL_TIMEOUT_MS    (5 * IMU_SAMPLE_RATE_MS)  /**< No sample for this long: motors are stopped */
#define IMU_DLPF_MODE           MPU6050_DLPF_BW_42        /**< ~42 Hz sensor bandwidth, ~4.8 ms delay */

/* Gyro bias: measured at start-up by the IMU task (AT+GYROBIAS?) */
/** @} */

/* ==========================================================================
 * Filter Configuration
 * ========================================================================== */

/** @defgroup Kalman_Config Kalman Filter Configuration
 *  @brief Kalman filter tuning parameters
 *  @{
 */
#define KALMAN_Q_ANGLE          0.1f    /**< Process noise (trust in gyro) */
#define KALMAN_R_MEASURE        0.5f    /**< Measurement noise (trust in accel) */
/** @} */

/** @defgroup Comp_Config Complementary Filter Configuration
 *  @brief Complementary filter tuning parameters
 *  @{
 */
#define COMPLEMENTARY_ALPHA     0.96f   /**< Default gyro weight; boards override with BOARD_COMPLEMENTARY_ALPHA, AT+ALPHA live */
/** @} */

/* ==========================================================================
 * Debug Configuration
 * ========================================================================== */

/** @defgroup Debug_Config Debug Configuration
 *  @brief Debug and logging settings
 *  @{
 */
#define LOG_BUFFER_SIZE         256     /**< Log message buffer size */
#define WATCHDOG_TIMEOUT_MS     500     /**< Independent watchdog timeout (WATCHDOG) */
#define AUTO_ENABLE_HOLD_MS     3000    /**< Upright time before AUTO_ENABLE starts balancing */
/** @} */

#ifdef __cplusplus
}
#endif // __cplusplus

#endif // CONFIG_H
```

## src/interrupts.c
```c
/**
 * @file interrupts.c
 * @brief Interrupt Service Routines (ISRs)
 *
 * Contains ISR implementations for DMA, I2C, and UART peripherals.
 * These override the weak default handlers from libopencm3; the handler
 * names come from board_config.h.
 *
 * @author Thiago Cunha
 * @date 2024
 */

#include <libopencm3/stm32/dma.h>
#include <libopencm3/cm3/nvic.h>

#include "board_config.h"
#include "drivers/i2c.h"
#include "drivers/uart.h"

/* ==========================================================================
 * I2C Event and Error Interrupt Handlers
 * ========================================================================== */

void BOARD_I2C_EV_ISR(void) {
    i2c_ev_isr(&i2c_board_bus);
}

void BOARD_I2C_ER_ISR(void) {
    i2c_er_isr(&i2c_board_bus);
}

/* ==========================================================================
 * I2C DMA TX / RX Interrupt Handlers
 * ========================================================================== */

void BOARD_I2C_DMA_TX_ISR(void) {
    i2c_dma_tx_isr(&i2c_board_bus);
}

void BOARD_I2C_DMA_RX_ISR(void) {
    i2c_dma_rx_isr(&i2c_board_bus);
}

/* ==========================================================================
 * UART Interrupt Handlers
 * ========================================================================== */

#if CONSOLE_USB
void BOARD_UART_ISR(void) {
    uart_isr(UART_PORT_USB);
}
#endif // CONSOLE_USB

#if CONSOLE_BT
void BOARD_BT_UART_ISR(void) {
    uart_isr(UART_PORT_BT);
}
#endif // CONSOLE_BT
```
